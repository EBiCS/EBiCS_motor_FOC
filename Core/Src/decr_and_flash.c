/*
 * decr_and_flash.c
 *
 *  Created on: 21.12.2021
 *      Author: Thanks to Tom!
 */

#include <stdio.h>
#include <stdint.h>
#include <string.h>
#include "main.h"

uint8_t key[16] = {0xFE,0x80,0x1C,0xB2,0xD1,0xEF,0x41,0xA6,0xA4,0x17,0x31,0xF5,0xA0,0x68,0x24,0xF0};
uint8_t iv[8] = {0x00,0x00,0x00,0x00,0x00,0x00,0x00,0x00};
int offset = 0;

void update_key()
{
    for (int i = 0; i < 16; i = i + 1) {
        key[i] = (key[i] + i) & 0xFF;
    }
    return;
}

void decrypt_ecb(uint8_t *block, uint8_t *out)
{
    uint32_t y, z;
    memcpy(&y, block, 4);
    memcpy(&z, block + 4, 4);

    uint32_t k[4];
    memcpy(&k[0], key, 4);
    memcpy(&k[1], key + 4, 4);
    memcpy(&k[2], key + 8, 4);
    memcpy(&k[3], key + 12, 4);

    uint32_t s = 0xC6EF3720;

    for (int i = 0; i < 32; i = i + 1) {
        z = (z - (((y << 4) + k[2]) ^ (y + s) ^ ((y >> 5) + k[3]))) & 0xFFFFFFFF;
        y = (y - (((z << 4) + k[0]) ^ (z + s) ^ ((z >> 5) + k[1]))) & 0xFFFFFFFF;
        s = (s - 0x9E3779B9) & 0xFFFFFFFF;
    }

    memcpy(out, &y, 4);
    memcpy(out + 4, &z, 4);

    return;
}

void xor(uint8_t *s1, uint8_t *s2){
    for (int i = 0; i < 8; i+=1) {
        s1[i] = s1[i] ^ s2[i];
    }
}

void decrypt(uint8_t *out, uint8_t *data, int len)
{
    int i;
    uint8_t tmp[8];

    for (i = 0; i < len; i = i + 8) {
        uint8_t ct[8];
        memcpy(ct, data + i, 8);

        decrypt_ecb(ct, tmp);
        xor(tmp, iv);

        memcpy(out + i, tmp, 8);
        memcpy(iv, ct, 8);
        offset += 8;
        if (offset % 1024 == 0) { update_key(); }
    }

    // unpad > remove last 8 bytes (could also verify checksum)

    return;
}

int decr_and_flash(uint8_t enc[], uint32_t flash_address)
{
   // uint8_t enc[128] = {0x80, 0x97, 0x66, 0xD3, 0x37, 0xD2, 0xB3, 0xB5, 0x79, 0x3E, 0x4C, 0xD0, 0xC9,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 0x4F, 0x73};
    uint8_t dec[128];
    uint32_t data;
    decrypt(dec, enc, sizeof(dec));
    HAL_FLASH_Unlock();
    char *source = (char *)&dec;
    char *target = (char *)&data;

    for(int i =0 ; i<128; i+=4){
		memcpy(target,source+i,4);
    	HAL_FLASH_Program(FLASH_TYPEPROGRAM_WORD, flash_address+i, data);
    }
    HAL_FLASH_Lock();

    return 0;
}
